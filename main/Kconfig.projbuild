## main/Kconfig.projbuild
```kconfig
menu "ESP32 lps22hh Configuration"

    menu "I2C Master"
        config I2C_MASTER_SCL
            int "SCL GPIO Num"
            default 26
            help
                GPIO number for I2C Master clock line.

        config I2C_MASTER_SDA
            int "SDA GPIO Num"
            default 27
            help
                GPIO number for I2C Master data line.

        config I2C_MASTER_PORT_NUM
            int "Port Number"
            default 0
            help
                Port number for I2C Master device.

        config I2C_MASTER_FREQUENCY
            int "Master Frequency"
            default 100000
            help
                I2C Speed of Master device.
    endmenu
    
endmenu

menu "BW - Wifi Configuration"

    config ESP_WIFI_SSID
        string "WiFi SSID"
        default "OnePlus 7 Pro"
        help
            SSID (network name) for the example to connect to.

    config ESP_WIFI_PASSWORD
        string "WiFi Password"
        default "test_rtc"
        help
            WiFi password (WPA or WPA2) for the example to use.

    config ESP_MAXIMUM_RETRY
        int "Maximum retry"
        default 5
        help
            Set the Maximum retry to avoid station reconnecting to the AP unlimited when the AP is really inexistent.
endmenu
```
